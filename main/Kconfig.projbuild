## main/Kconfig.projbuild
```kconfig
menu "ButtHeat config"

  config TX_GPIO_NUM
    int "TX GPIO number"
    default 21 if IDF_TARGET_ESP32
	default 0
	help
	  Select GPIO pin for CAN TX

  config RX_GPIO_NUM
    int "RX GPIO number"
    default 22 if IDF_TARGET_ESP32
	default 2
	help
	  Select GPIO pin for CAN RX

  config ENCODER_LEFT_A
    int "Left Seat Encoder Pin A GPIO"
    default 2

  config ENCODER_LEFT_B
    int "Left Seat Encoder Pin B GPIO"
    default 3

  config BTN_LEFT
    int "Left Seat Button GPIO"
    default 4

  config ENCODER_RIGHT_A
    int "Right Seat Encoder Pin A GPIO"
    default 5

  config ENCODER_RIGHT_B
    int "Right Seat Encoder Pin B GPIO"
    default 6

  config BTN_RIGHT
    int "Right Seat Button GPIO"
    default 7

  config TX_SETTLE_TIMEOUT_MS
    int "How many ms to wait for acceptance after sending change command"
    default 250

endmenu
```
